/******************************************************************************
* ASAP2 file: HANcoder_E407_TTA_CombineModel.a2l
* Academic License - for use in teaching, academic research, and meeting
* course requirements at degree granting institutions only. Not for
* government, commercial, or other organizational use.
* Code generation for model "HANcoder_E407_TTA_CombineModel".
* Model version : 17.41
* Simulink Coder version : 9.8 (R2022b) 13-May-2022
* C source code generated on : Tue Jun 20 16:14:01 2023
* Target selection: ert.tlc
* Embedded hardware selection: ARM Compatible->ARM Cortex
* Code generation objectives: Unspecified
* Validation result: Not run
* (add additional file header information here)
******************************************************************************/ ASAP2_VERSION 1 31
/* Version 1.31 */
/begin PROJECT ProjectName "HANcoder_E407_TTA_CombineModel_softwareID_v1_200623_161224"
/begin HEADER "Header Comments go here" /end HEADER
/begin MODULE ModuleName "Module Comment Goes Here"
/begin MOD_PAR "MOD PAR Comment Goes Here" ADDR_EPK 0x0800c070 CPU_TYPE "STM32F407" ECU "E407" EPK "HANcoder_E407_TTA_CombineModel_softwareID_v1_200623_161224"
 SYSTEM_CONSTANT "XcpStationID string length" "0x0000003a"
 SYSTEM_CONSTANT "RAM-FlashOffset" "-402532896" /end MOD_PAR
/begin MOD_COMMON "Mod Common Comment Here" BYTE_ORDER MSB_LAST /end MOD_COMMON
/begin RECORD_LAYOUT Scalar_BOOLEAN FNC_VALUES 1 UBYTE COLUMN_DIR DIRECT /end RECORD_LAYOUT
/begin RECORD_LAYOUT Scalar_UBYTE FNC_VALUES 1 UBYTE COLUMN_DIR DIRECT /end RECORD_LAYOUT
/begin RECORD_LAYOUT Scalar_BYTE FNC_VALUES 1 SBYTE COLUMN_DIR DIRECT /end RECORD_LAYOUT
/begin RECORD_LAYOUT Scalar_UWORD FNC_VALUES 1 UWORD COLUMN_DIR DIRECT /end RECORD_LAYOUT
/begin RECORD_LAYOUT Scalar_SWORD FNC_VALUES 1 SWORD COLUMN_DIR DIRECT /end RECORD_LAYOUT
/begin RECORD_LAYOUT Scalar_ULONG FNC_VALUES 1 ULONG COLUMN_DIR DIRECT /end RECORD_LAYOUT
/begin RECORD_LAYOUT Scalar_LONG FNC_VALUES 1 SLONG COLUMN_DIR DIRECT /end RECORD_LAYOUT
/begin RECORD_LAYOUT Scalar_FLOAT32_IEEE FNC_VALUES 1 FLOAT32_IEEE COLUMN_DIR DIRECT /end RECORD_LAYOUT
/begin RECORD_LAYOUT Scalar_FLOAT64_IEEE FNC_VALUES 1 FLOAT64_IEEE COLUMN_DIR DIRECT /end RECORD_LAYOUT
/begin RECORD_LAYOUT Lookup1D_BYTE FNC_VALUES 1 SBYTE COLUMN_DIR DIRECT /end RECORD_LAYOUT
/begin RECORD_LAYOUT Lookup1D_X_BYTE AXIS_PTS_X 1 SBYTE INDEX_INCR DIRECT /end RECORD_LAYOUT
/begin RECORD_LAYOUT Lookup1D_UBYTE FNC_VALUES 1 UBYTE COLUMN_DIR DIRECT /end RECORD_LAYOUT
/begin RECORD_LAYOUT Lookup1D_X_UBYTE AXIS_PTS_X 1 UBYTE INDEX_INCR DIRECT /end RECORD_LAYOUT
/begin RECORD_LAYOUT Lookup1D_UWORD FNC_VALUES 1 UWORD COLUMN_DIR DIRECT /end RECORD_LAYOUT
/begin RECORD_LAYOUT Lookup1D_X_UWORD AXIS_PTS_X 1 UWORD INDEX_INCR DIRECT /end RECORD_LAYOUT
/begin RECORD_LAYOUT Lookup1D_WORD FNC_VALUES 1 SWORD COLUMN_DIR DIRECT /end RECORD_LAYOUT
/begin RECORD_LAYOUT Lookup1D_X_WORD AXIS_PTS_X 1 SWORD INDEX_INCR DIRECT /end RECORD_LAYOUT
/begin RECORD_LAYOUT Lookup1D_ULONG FNC_VALUES 1 ULONG COLUMN_DIR DIRECT /end RECORD_LAYOUT
/begin RECORD_LAYOUT Lookup1D_X_ULONG AXIS_PTS_X 1 ULONG INDEX_INCR DIRECT /end RECORD_LAYOUT
/begin RECORD_LAYOUT Lookup1D_SLONG FNC_VALUES 1 SLONG COLUMN_DIR DIRECT /end RECORD_LAYOUT
/begin RECORD_LAYOUT Lookup1D_X_LONG AXIS_PTS_X 1 SLONG INDEX_INCR DIRECT /end RECORD_LAYOUT
/begin RECORD_LAYOUT Lookup1D_FLOAT32_IEEE FNC_VALUES 1 FLOAT32_IEEE COLUMN_DIR DIRECT /end RECORD_LAYOUT
/begin RECORD_LAYOUT Lookup1D_X_FLOAT32_IEEE AXIS_PTS_X 1 FLOAT32_IEEE INDEX_INCR DIRECT /end RECORD_LAYOUT
/begin RECORD_LAYOUT Lookup1D_FLOAT64_IEEE FNC_VALUES 1 FLOAT64_IEEE COLUMN_DIR DIRECT /end RECORD_LAYOUT
/begin RECORD_LAYOUT Lookup1D_X_FLOAT64_IEEE AXIS_PTS_X 1 FLOAT64_IEEE INDEX_INCR DIRECT /end RECORD_LAYOUT
/begin RECORD_LAYOUT Lookup2D_UBYTE FNC_VALUES 1 UBYTE COLUMN_DIR DIRECT /end RECORD_LAYOUT
/begin RECORD_LAYOUT Lookup2D_X_UBYTE AXIS_PTS_X 1 UBYTE INDEX_INCR DIRECT /end RECORD_LAYOUT
/begin RECORD_LAYOUT Lookup2D_BYTE FNC_VALUES 1 SBYTE COLUMN_DIR DIRECT /end RECORD_LAYOUT
/begin RECORD_LAYOUT Lookup2D_X_BYTE AXIS_PTS_X 1 SBYTE INDEX_INCR DIRECT /end RECORD_LAYOUT
/begin RECORD_LAYOUT Lookup2D_UWORD FNC_VALUES 1 UWORD COLUMN_DIR DIRECT /end RECORD_LAYOUT
/begin RECORD_LAYOUT Lookup2D_X_UWORD AXIS_PTS_X 1 UWORD INDEX_INCR DIRECT /end RECORD_LAYOUT
/begin RECORD_LAYOUT Lookup2D_WORD FNC_VALUES 1 SWORD COLUMN_DIR DIRECT /end RECORD_LAYOUT
/begin RECORD_LAYOUT Lookup2D_X_WORD AXIS_PTS_X 1 SWORD INDEX_INCR DIRECT /end RECORD_LAYOUT
/begin RECORD_LAYOUT Lookup2D_ULONG FNC_VALUES 1 ULONG COLUMN_DIR DIRECT /end RECORD_LAYOUT
/begin RECORD_LAYOUT Lookup2D_X_ULONG AXIS_PTS_X 1 ULONG INDEX_INCR DIRECT /end RECORD_LAYOUT
/begin RECORD_LAYOUT Lookup2D_LONG FNC_VALUES 1 SLONG COLUMN_DIR DIRECT /end RECORD_LAYOUT
/begin RECORD_LAYOUT Lookup2D_X_LONG AXIS_PTS_X 1 SLONG INDEX_INCR DIRECT /end RECORD_LAYOUT
/begin RECORD_LAYOUT Lookup2D_FLOAT32_IEEE FNC_VALUES 1 FLOAT32_IEEE COLUMN_DIR DIRECT /end RECORD_LAYOUT
/begin RECORD_LAYOUT Lookup2D_X_FLOAT32_IEEE AXIS_PTS_X 1 FLOAT32_IEEE INDEX_INCR DIRECT /end RECORD_LAYOUT
/begin RECORD_LAYOUT Lookup2D_FLOAT64_IEEE FNC_VALUES 1 FLOAT64_IEEE COLUMN_DIR DIRECT /end RECORD_LAYOUT
/begin RECORD_LAYOUT Lookup2D_X_FLOAT64_IEEE AXIS_PTS_X 1 FLOAT64_IEEE INDEX_INCR DIRECT /end RECORD_LAYOUT
/begin CHARACTERISTIC ClockOn "" VALUE 0x20000008 Scalar_FLOAT64_IEEE 0 HANcoder_E407_TTA_CombineModel_CM_double -1.7E+308 1.7E+308 /end CHARACTERISTIC
/begin CHARACTERISTIC ResetPosition "" VALUE 0x20000018 Scalar_FLOAT64_IEEE 0 HANcoder_E407_TTA_CombineModel_CM_double -1.7E+308 1.7E+308 /end CHARACTERISTIC
/begin CHARACTERISTIC controlWidth "" VALUE 0x20000040 Scalar_FLOAT64_IEEE 0 HANcoder_E407_TTA_CombineModel_CM_double -1.7E+308 1.7E+308 /end CHARACTERISTIC
/begin CHARACTERISTIC desiredAngle "" VALUE 0x20000048 Scalar_FLOAT64_IEEE 0 HANcoder_E407_TTA_CombineModel_CM_double -1.7E+308 1.7E+308 /end CHARACTERISTIC
/begin CHARACTERISTIC intVal "" VALUE 0x20000050 Scalar_FLOAT64_IEEE 0 HANcoder_E407_TTA_CombineModel_CM_double -1.7E+308 1.7E+308 /end CHARACTERISTIC
/begin CHARACTERISTIC manual "" VALUE 0x20000058 Scalar_FLOAT64_IEEE 0 HANcoder_E407_TTA_CombineModel_CM_double -1.7E+308 1.7E+308 /end CHARACTERISTIC
/begin CHARACTERISTIC matrixRows "" VALUE 0x20000060 Scalar_FLOAT64_IEEE 0 HANcoder_E407_TTA_CombineModel_CM_double -1.7E+308 1.7E+308 /end CHARACTERISTIC
/begin CHARACTERISTIC propVal "" VALUE 0x20000070 Scalar_FLOAT64_IEEE 0 HANcoder_E407_TTA_CombineModel_CM_double -1.7E+308 1.7E+308 /end CHARACTERISTIC
/begin CHARACTERISTIC MMBS1_ID "" VALUE 0x20000010 Scalar_ULONG 0 HANcoder_E407_TTA_CombineModel_CM_uint32 0 4294967295 /end CHARACTERISTIC
/begin CHARACTERISTIC SSTM1_ID "" VALUE 0x20000020 Scalar_ULONG 0 HANcoder_E407_TTA_CombineModel_CM_uint32 0 4294967295 /end CHARACTERISTIC
/begin CHARACTERISTIC SYNC1_ID "" VALUE 0x20000024 Scalar_ULONG 0 HANcoder_E407_TTA_CombineModel_CM_uint32 0 4294967295 /end CHARACTERISTIC
/begin CHARACTERISTIC TRCK1_ID1 "" VALUE 0x20000028 Scalar_ULONG 0 HANcoder_E407_TTA_CombineModel_CM_uint32 0 4294967295 /end CHARACTERISTIC
/begin CHARACTERISTIC TRCK1_ID2 "" VALUE 0x2000002c Scalar_ULONG 0 HANcoder_E407_TTA_CombineModel_CM_uint32 0 4294967295 /end CHARACTERISTIC
/begin CHARACTERISTIC TRCK1_ID3 "" VALUE 0x20000030 Scalar_ULONG 0 HANcoder_E407_TTA_CombineModel_CM_uint32 0 4294967295 /end CHARACTERISTIC
/begin CHARACTERISTIC TRLS1_ID4 "" VALUE 0x20000034 Scalar_ULONG 0 HANcoder_E407_TTA_CombineModel_CM_uint32 0 4294967295 /end CHARACTERISTIC
/begin CHARACTERISTIC TRLS1_ID5 "" VALUE 0x20000038 Scalar_ULONG 0 HANcoder_E407_TTA_CombineModel_CM_uint32 0 4294967295 /end CHARACTERISTIC
/begin CHARACTERISTIC maxMissedMessages "" VALUE 0x20000068 Scalar_UBYTE 0 HANcoder_E407_TTA_CombineModel_CM_uint8 0 255 /end CHARACTERISTIC
/begin CHARACTERISTIC slotTime "" VALUE 0x20000078 Scalar_UBYTE 0 HANcoder_E407_TTA_CombineModel_CM_uint8 0 255 /end CHARACTERISTIC
/begin MEASUREMENT Gamma1 "" FLOAT64_IEEE HANcoder_E407_TTA_CombineModel_CM_double 0 0 -1.7E+308 1.7E+308 ECU_ADDRESS 0x20000270 /end MEASUREMENT
/begin MEASUREMENT steering "" FLOAT64_IEEE HANcoder_E407_TTA_CombineModel_CM_double 0 0 -1.7E+308 1.7E+308 ECU_ADDRESS 0x200006f0 /end MEASUREMENT
/begin MEASUREMENT position "" FLOAT64_IEEE HANcoder_E407_TTA_CombineModel_CM_double 0 0 -1.7E+308 1.7E+308 ECU_ADDRESS 0x20000350 /end MEASUREMENT
/begin MEASUREMENT control "" FLOAT64_IEEE HANcoder_E407_TTA_CombineModel_CM_double 0 0 -1.7E+308 1.7E+308 ECU_ADDRESS 0x200002e0 /end MEASUREMENT
/begin MEASUREMENT SI_FreeHeap "" ULONG HANcoder_E407_TTA_CombineModel_CM_uint32 0 0 0 4294967295 ECU_ADDRESS 0x2000027c /end MEASUREMENT
/begin MEASUREMENT SI_FreeStack "" ULONG HANcoder_E407_TTA_CombineModel_CM_uint32 0 0 0 4294967295 ECU_ADDRESS 0x20000280 /end MEASUREMENT
/begin MEASUREMENT delta12K "" FLOAT32_IEEE HANcoder_E407_TTA_CombineModel_CM_single 0 0 -3.4E+38 3.4E+38 ECU_ADDRESS 0x200002ec /end MEASUREMENT
/begin MEASUREMENT motorPos "" SLONG HANcoder_E407_TTA_CombineModel_CM_int32 0 0 -2147483648 2147483647 ECU_ADDRESS 0x20000344 /end MEASUREMENT
/begin MEASUREMENT pot31 "" UWORD HANcoder_E407_TTA_CombineModel_CM_uint16 0 0 0 65535 ECU_ADDRESS 0x20000366 /end MEASUREMENT
/begin MEASUREMENT pot32 "" UWORD HANcoder_E407_TTA_CombineModel_CM_uint16 0 0 0 65535 ECU_ADDRESS 0x20000368 /end MEASUREMENT
/begin MEASUREMENT pot11 "" UWORD HANcoder_E407_TTA_CombineModel_CM_uint16 0 0 0 65535 ECU_ADDRESS 0x2000035c /end MEASUREMENT
/begin MEASUREMENT pot12 "" UWORD HANcoder_E407_TTA_CombineModel_CM_uint16 0 0 0 65535 ECU_ADDRESS 0x2000035e /end MEASUREMENT
/begin MEASUREMENT pot21 "" UWORD HANcoder_E407_TTA_CombineModel_CM_uint16 0 0 0 65535 ECU_ADDRESS 0x20000362 /end MEASUREMENT
/begin MEASUREMENT pot22 "" UWORD HANcoder_E407_TTA_CombineModel_CM_uint16 0 0 0 65535 ECU_ADDRESS 0x20000364 /end MEASUREMENT
/begin MEASUREMENT testCounter "" UWORD HANcoder_E407_TTA_CombineModel_CM_uint16 0 0 0 65535 ECU_ADDRESS 0x200006fc /end MEASUREMENT
/begin MEASUREMENT potRaw "" UWORD HANcoder_E407_TTA_CombineModel_CM_uint16 0 0 0 65535 ECU_ADDRESS 0x2000036c /end MEASUREMENT
/begin MEASUREMENT lastPot "" UWORD HANcoder_E407_TTA_CombineModel_CM_uint16 0 0 0 65535 ECU_ADDRESS 0x20000336 /end MEASUREMENT
/begin MEASUREMENT analogPot1 "" UWORD HANcoder_E407_TTA_CombineModel_CM_uint16 0 0 0 65535 ECU_ADDRESS 0x20000286 /end MEASUREMENT
/begin MEASUREMENT pot1 "" UWORD HANcoder_E407_TTA_CombineModel_CM_uint16 0 0 0 65535 ECU_ADDRESS 0x2000035a /end MEASUREMENT
/begin MEASUREMENT analogPot2 "" UWORD HANcoder_E407_TTA_CombineModel_CM_uint16 0 0 0 65535 ECU_ADDRESS 0x20000288 /end MEASUREMENT
/begin MEASUREMENT pot2 "" UWORD HANcoder_E407_TTA_CombineModel_CM_uint16 0 0 0 65535 ECU_ADDRESS 0x20000360 /end MEASUREMENT
/begin MEASUREMENT outputPwm "" UWORD HANcoder_E407_TTA_CombineModel_CM_uint16 0 0 0 65535 ECU_ADDRESS 0x2000034a /end MEASUREMENT
/begin MEASUREMENT reqAngle "" UWORD HANcoder_E407_TTA_CombineModel_CM_uint16 0 0 0 65535 ECU_ADDRESS 0x2000036e /end MEASUREMENT
/begin MEASUREMENT t2Angle "" UWORD HANcoder_E407_TTA_CombineModel_CM_uint16 0 0 0 65535 ECU_ADDRESS 0x200006fa /end MEASUREMENT
/begin MEASUREMENT t1Angle "" UWORD HANcoder_E407_TTA_CombineModel_CM_uint16 0 0 0 65535 ECU_ADDRESS 0x200006f8 /end MEASUREMENT
/begin MEASUREMENT Gamma2 "" UWORD HANcoder_E407_TTA_CombineModel_CM_uint16 0 0 0 65535 ECU_ADDRESS 0x20000278 /end MEASUREMENT
/begin MEASUREMENT mospeed "" UWORD HANcoder_E407_TTA_CombineModel_CM_uint16 0 0 0 65535 ECU_ADDRESS 0x20000340 /end MEASUREMENT
/begin MEASUREMENT errors "" UBYTE HANcoder_E407_TTA_CombineModel_CM_uint8 0 0 0 255 ECU_ADDRESS 0x20000334 /end MEASUREMENT
/begin MEASUREMENT SI_CPUload "" UBYTE HANcoder_E407_TTA_CombineModel_CM_uint8 0 0 0 255 ECU_ADDRESS 0x2000027a /end MEASUREMENT
/begin MEASUREMENT buttonpress2 "" UBYTE HANcoder_E407_TTA_CombineModel_CM_uint8 0 0 0 255 ECU_ADDRESS 0x2000028c /end MEASUREMENT
/begin MEASUREMENT buttonpress1 "" UBYTE HANcoder_E407_TTA_CombineModel_CM_uint8 0 0 0 255 ECU_ADDRESS 0x2000028b /end MEASUREMENT
/begin MEASUREMENT missedMasterMessages "" UBYTE HANcoder_E407_TTA_CombineModel_CM_uint8 0 0 0 255 ECU_ADDRESS 0x2000033f /end MEASUREMENT
/begin MEASUREMENT amounttrailers "" UBYTE HANcoder_E407_TTA_CombineModel_CM_uint8 0 0 0 255 ECU_ADDRESS 0x20000284 /end MEASUREMENT
/begin MEASUREMENT positionID5 "" UBYTE HANcoder_E407_TTA_CombineModel_CM_uint8 0 0 0 255 ECU_ADDRESS 0x20000359 /end MEASUREMENT
/begin MEASUREMENT positionID4 "" UBYTE HANcoder_E407_TTA_CombineModel_CM_uint8 0 0 0 255 ECU_ADDRESS 0x20000358 /end MEASUREMENT
/begin MEASUREMENT local_ticks_interrupt "" UBYTE HANcoder_E407_TTA_CombineModel_CM_uint8 0 0 0 255 ECU_ADDRESS 0x20000338 /end MEASUREMENT
/begin MEASUREMENT setSlotTime "" UBYTE HANcoder_E407_TTA_CombineModel_CM_uint8 0 0 0 255 ECU_ADDRESS 0x200006ee /end MEASUREMENT
/begin MEASUREMENT slotSelected "" UBYTE HANcoder_E407_TTA_CombineModel_CM_uint8 0 0 0 255 ECU_ADDRESS 0x200006ef /end MEASUREMENT
/begin MEASUREMENT boolCan "" UBYTE HANcoder_E407_TTA_CombineModel_CM_boolean 0 0 0 1 ECU_ADDRESS 0x2000028a /end MEASUREMENT
/begin MEASUREMENT potFaultDetected "" UBYTE HANcoder_E407_TTA_CombineModel_CM_boolean 0 0 0 1 ECU_ADDRESS 0x2000036a /end MEASUREMENT
/begin MEASUREMENT masterCanFail "" UBYTE HANcoder_E407_TTA_CombineModel_CM_boolean 0 0 0 1 ECU_ADDRESS 0x20000339 /end MEASUREMENT
/begin MEASUREMENT mf1 "" UBYTE HANcoder_E407_TTA_CombineModel_CM_boolean 0 0 0 1 ECU_ADDRESS 0x2000033a /end MEASUREMENT
/begin MEASUREMENT mf2 "" UBYTE HANcoder_E407_TTA_CombineModel_CM_boolean 0 0 0 1 ECU_ADDRESS 0x2000033b /end MEASUREMENT
/begin MEASUREMENT mf3 "" UBYTE HANcoder_E407_TTA_CombineModel_CM_boolean 0 0 0 1 ECU_ADDRESS 0x2000033c /end MEASUREMENT
/begin MEASUREMENT mf4 "" UBYTE HANcoder_E407_TTA_CombineModel_CM_boolean 0 0 0 1 ECU_ADDRESS 0x2000033d /end MEASUREMENT
/begin MEASUREMENT mf5 "" UBYTE HANcoder_E407_TTA_CombineModel_CM_boolean 0 0 0 1 ECU_ADDRESS 0x2000033e /end MEASUREMENT
/begin MEASUREMENT motorFaultDetected "" UBYTE HANcoder_E407_TTA_CombineModel_CM_boolean 0 0 0 1 ECU_ADDRESS 0x20000342 /end MEASUREMENT
/begin MEASUREMENT outputD4 "" UBYTE HANcoder_E407_TTA_CombineModel_CM_boolean 0 0 0 1 ECU_ADDRESS 0x20000348 /end MEASUREMENT
/begin MEASUREMENT outputD5 "" UBYTE HANcoder_E407_TTA_CombineModel_CM_boolean 0 0 0 1 ECU_ADDRESS 0x20000349 /end MEASUREMENT
/begin MEASUREMENT ioInit "" UBYTE HANcoder_E407_TTA_CombineModel_CM_boolean 0 0 0 1 ECU_ADDRESS 0x20000335 /end MEASUREMENT
/begin MEASUREMENT cw "" UBYTE HANcoder_E407_TTA_CombineModel_CM_boolean 0 0 0 1 ECU_ADDRESS 0x200002e8 /end MEASUREMENT
/begin MEASUREMENT ccw "" UBYTE HANcoder_E407_TTA_CombineModel_CM_boolean 0 0 0 1 ECU_ADDRESS 0x200002d8 /end MEASUREMENT
/begin MEASUREMENT canActive "" UBYTE HANcoder_E407_TTA_CombineModel_CM_boolean 0 0 0 1 ECU_ADDRESS 0x2000028d /end MEASUREMENT
/begin COMPU_METHOD HANcoder_E407_TTA_CombineModel_CM_double "Q = V" RAT_FUNC "%15.10" "" COEFFS 0 1 0 0 0 1 /end COMPU_METHOD
/begin COMPU_METHOD HANcoder_E407_TTA_CombineModel_CM_uint32 "Q = V" RAT_FUNC "%10.0" "" COEFFS 0 1 0 0 0 1 /end COMPU_METHOD
/begin COMPU_METHOD HANcoder_E407_TTA_CombineModel_CM_uint8 "Q = V" RAT_FUNC "%3.0" "" COEFFS 0 1 0 0 0 1 /end COMPU_METHOD
/begin COMPU_METHOD HANcoder_E407_TTA_CombineModel_CM_single "Q = V" RAT_FUNC "%8.6" "" COEFFS 0 1 0 0 0 1 /end COMPU_METHOD
/begin COMPU_METHOD HANcoder_E407_TTA_CombineModel_CM_int32 "Q = V" RAT_FUNC "%10.0" "" COEFFS 0 1 0 0 0 1 /end COMPU_METHOD
/begin COMPU_METHOD HANcoder_E407_TTA_CombineModel_CM_uint16 "Q = V" RAT_FUNC "%5.0" "" COEFFS 0 1 0 0 0 1 /end COMPU_METHOD
/begin COMPU_METHOD HANcoder_E407_TTA_CombineModel_CM_boolean "Q = V" RAT_FUNC "%1.0" "" COEFFS 0 1 0 0 0 1 /end COMPU_METHOD
/begin GROUP HANcoder_E407_TTA_CombineModel "HANcoder_E407_TTA_CombineModel" /* Root */ ROOT /begin SUB_GROUP Root_HANcoder_STM32_Target___E407_STM32_algorithm /end SUB_GROUP /end GROUP
/begin GROUP Root_HANcoder_STM32_Target___E407_STM32_algorithm "HANcoder_E407_TTA_CombineModel/HANcoder STM32 Target - E407-STM32 algorithm"
 /begin SUB_GROUP S1_Control_execution S1_IO_execution S1_Local_Time_generation S1_Message_selector S1_Role_assignment S1_System_information S1_Total_Errors S1_Triggered_Subsystem /end SUB_GROUP
/end GROUP
/begin GROUP S1_Control_execution "HANcoder_E407_TTA_CombineModel/HANcoder STM32 Target - E407-STM32 algorithm/Control execution" /begin SUB_GROUP S5_Control_Algorithm S5_Kinematic_Algorithm /end SUB_GROUP /begin REF_MEASUREMENT reqAngle t1Angle t2Angle /end REF_MEASUREMENT /end GROUP
/begin GROUP S1_IO_execution "HANcoder_E407_TTA_CombineModel/HANcoder STM32 Target - E407-STM32 algorithm/IO execution" /begin SUB_GROUP S7_Inputs S7_Outputs S7_Voting /end SUB_GROUP /end GROUP
/begin GROUP S1_Local_Time_generation "HANcoder_E407_TTA_CombineModel/HANcoder STM32 Target - E407-STM32 algorithm/Local Time generation" /begin SUB_GROUP S9_Enabled_Subsystem /end SUB_GROUP /begin REF_MEASUREMENT canActive local_ticks_interrupt setSlotTime /end REF_MEASUREMENT /end GROUP
/begin GROUP S1_Message_selector "HANcoder_E407_TTA_CombineModel/HANcoder STM32 Target - E407-STM32 algorithm/Message selector"
 /begin SUB_GROUP S10_MMBS1_RX S10_SYNC1_TX S10_TRCK1_ID2_RX S10_TRCK1_RX S10_TRCK1_TX S10_TRCK_ID3_RX S10_TRLS_ID4_RX S10_TRLS_ID5_RX /end SUB_GROUP
 /begin REF_CHARACTERISTIC MMBS1_ID SSTM1_ID SYNC1_ID TRCK1_ID1 TRCK1_ID2 TRCK1_ID3 TRLS1_ID4 TRLS1_ID5 /end REF_CHARACTERISTIC
 /begin REF_MEASUREMENT boolCan /end REF_MEASUREMENT
/end GROUP
/begin GROUP S1_Role_assignment "HANcoder_E407_TTA_CombineModel/HANcoder STM32 Target - E407-STM32 algorithm/Role assignment" /begin SUB_GROUP S12_Subsystem S12_Subsystem2 /end SUB_GROUP /begin REF_CHARACTERISTIC ClockOn /end REF_CHARACTERISTIC /end GROUP
/begin GROUP S1_System_information "HANcoder_E407_TTA_CombineModel/HANcoder STM32 Target - E407-STM32 algorithm/System information" /begin SUB_GROUP S15_Get_CPU_load S15_Get_free_Heap S15_Get_free_Stack /end SUB_GROUP /end GROUP
/begin GROUP S1_Total_Errors "HANcoder_E407_TTA_CombineModel/HANcoder STM32 Target - E407-STM32 algorithm/Total Errors" /begin REF_MEASUREMENT errors /end REF_MEASUREMENT /end GROUP
/begin GROUP S1_Triggered_Subsystem "HANcoder_E407_TTA_CombineModel/HANcoder STM32 Target - E407-STM32 algorithm/Triggered Subsystem" /begin SUB_GROUP S17_Subsystem /end SUB_GROUP /begin REF_MEASUREMENT amounttrailers positionID4 positionID5 /end REF_MEASUREMENT /end GROUP
/begin GROUP S5_Control_Algorithm "HANcoder_E407_TTA_CombineModel/HANcoder STM32 Target - E407-STM32 algorithm/Control execution/Control Algorithm" /begin REF_CHARACTERISTIC controlWidth /end REF_CHARACTERISTIC /begin REF_MEASUREMENT ccw control cw mospeed position steering /end REF_MEASUREMENT /end GROUP
/begin GROUP S5_Kinematic_Algorithm "HANcoder_E407_TTA_CombineModel/HANcoder STM32 Target - E407-STM32 algorithm/Control execution/Kinematic Algorithm" /begin SUB_GROUP S20_Steer_angle_at_steer_axle /end SUB_GROUP /begin REF_MEASUREMENT Gamma1 Gamma2 /end REF_MEASUREMENT /end GROUP
/begin GROUP S7_Inputs "HANcoder_E407_TTA_CombineModel/HANcoder STM32 Target - E407-STM32 algorithm/IO execution/Inputs"
 /begin SUB_GROUP S78_Quadrature_Encoder_Get S78_Trailer1_Angle S78_Trailer2_Angle /end SUB_GROUP
 /begin REF_MEASUREMENT ioInit pot1 pot2 /end REF_MEASUREMENT
/end GROUP
/begin GROUP S7_Outputs "HANcoder_E407_TTA_CombineModel/HANcoder STM32 Target - E407-STM32 algorithm/IO execution/Outputs" /begin REF_MEASUREMENT outputD4 outputD5 outputPwm /end REF_MEASUREMENT /end GROUP
/begin GROUP S7_Voting "HANcoder_E407_TTA_CombineModel/HANcoder STM32 Target - E407-STM32 algorithm/IO execution/Voting" /begin REF_CHARACTERISTIC desiredAngle manual /end REF_CHARACTERISTIC /begin REF_MEASUREMENT lastPot mf1 mf2 mf3 mf4 mf5 motorFaultDetected potRaw /end REF_MEASUREMENT /end GROUP
/begin GROUP S9_Enabled_Subsystem "HANcoder_E407_TTA_CombineModel/HANcoder STM32 Target - E407-STM32 algorithm/Local Time generation/Enabled Subsystem" /begin REF_CHARACTERISTIC matrixRows /end REF_CHARACTERISTIC /begin REF_MEASUREMENT slotSelected /end REF_MEASUREMENT /end GROUP
/begin GROUP S10_MMBS1_RX "HANcoder_E407_TTA_CombineModel/HANcoder STM32 Target - E407-STM32 algorithm/Message selector/MMBS1_RX" /begin REF_CHARACTERISTIC maxMissedMessages /end REF_CHARACTERISTIC /begin REF_MEASUREMENT masterCanFail missedMasterMessages /end REF_MEASUREMENT /end GROUP
/begin GROUP S10_SYNC1_TX "HANcoder_E407_TTA_CombineModel/HANcoder STM32 Target - E407-STM32 algorithm/Message selector/SYNC1_TX" /begin REF_MEASUREMENT testCounter /end REF_MEASUREMENT /end GROUP
/begin GROUP S10_TRCK1_ID2_RX "HANcoder_E407_TTA_CombineModel/HANcoder STM32 Target - E407-STM32 algorithm/Message selector/TRCK1_ID2_RX" /begin SUB_GROUP S109_2bytes2uint1 S109_2bytes2uint16 /end SUB_GROUP /end GROUP
/begin GROUP S10_TRCK1_RX "HANcoder_E407_TTA_CombineModel/HANcoder STM32 Target - E407-STM32 algorithm/Message selector/TRCK1_RX" /begin SUB_GROUP S112_2bytes2uint1 S112_2bytes2uint16 /end SUB_GROUP /end GROUP
/begin GROUP S10_TRCK1_TX "HANcoder_E407_TTA_CombineModel/HANcoder STM32 Target - E407-STM32 algorithm/Message selector/TRCK1_TX" /begin REF_MEASUREMENT potFaultDetected /end REF_MEASUREMENT /end GROUP
/begin GROUP S10_TRCK_ID3_RX "HANcoder_E407_TTA_CombineModel/HANcoder STM32 Target - E407-STM32 algorithm/Message selector/TRCK_ID3_RX" /begin SUB_GROUP S114_2bytes2uint1 S114_2bytes2uint16 /end SUB_GROUP /end GROUP
/begin GROUP S10_TRLS_ID4_RX "HANcoder_E407_TTA_CombineModel/HANcoder STM32 Target - E407-STM32 algorithm/Message selector/TRLS_ID4_RX" /begin SUB_GROUP S115_CAN_receive1 /end SUB_GROUP /end GROUP
/begin GROUP S10_TRLS_ID5_RX "HANcoder_E407_TTA_CombineModel/HANcoder STM32 Target - E407-STM32 algorithm/Message selector/TRLS_ID5_RX" /begin SUB_GROUP S117_CAN_receive1 /end SUB_GROUP /end GROUP
/begin GROUP S12_Subsystem "HANcoder_E407_TTA_CombineModel/HANcoder STM32 Target - E407-STM32 algorithm/Role assignment/Subsystem" /begin REF_CHARACTERISTIC slotTime /end REF_CHARACTERISTIC /end GROUP
/begin GROUP S12_Subsystem2 "HANcoder_E407_TTA_CombineModel/HANcoder STM32 Target - E407-STM32 algorithm/Role assignment/Subsystem2" /begin REF_CHARACTERISTIC SYNC1_ID /end REF_CHARACTERISTIC /end GROUP
/begin GROUP S15_Get_CPU_load "HANcoder_E407_TTA_CombineModel/HANcoder STM32 Target - E407-STM32 algorithm/System information/Get CPU load" /begin REF_MEASUREMENT SI_CPUload /end REF_MEASUREMENT /end GROUP
/begin GROUP S15_Get_free_Heap "HANcoder_E407_TTA_CombineModel/HANcoder STM32 Target - E407-STM32 algorithm/System information/Get free Heap" /begin REF_MEASUREMENT SI_FreeHeap /end REF_MEASUREMENT /end GROUP
/begin GROUP S15_Get_free_Stack "HANcoder_E407_TTA_CombineModel/HANcoder STM32 Target - E407-STM32 algorithm/System information/Get free Stack" /begin REF_MEASUREMENT SI_FreeStack /end REF_MEASUREMENT /end GROUP
/begin GROUP S17_Subsystem "HANcoder_E407_TTA_CombineModel/HANcoder STM32 Target - E407-STM32 algorithm/Triggered Subsystem/Subsystem" /begin REF_CHARACTERISTIC ResetPosition /end REF_CHARACTERISTIC /end GROUP
/begin GROUP S20_Steer_angle_at_steer_axle "HANcoder_E407_TTA_CombineModel/HANcoder STM32 Target - E407-STM32 algorithm/Control execution/Kinematic Algorithm/Steer angle at steer axle" /begin REF_MEASUREMENT delta12K /end REF_MEASUREMENT /end GROUP
/begin GROUP S78_Quadrature_Encoder_Get "HANcoder_E407_TTA_CombineModel/HANcoder STM32 Target - E407-STM32 algorithm/IO execution/Inputs/Quadrature Encoder Get" /begin REF_MEASUREMENT motorPos /end REF_MEASUREMENT /end GROUP
/begin GROUP S78_Trailer1_Angle "HANcoder_E407_TTA_CombineModel/HANcoder STM32 Target - E407-STM32 algorithm/IO execution/Inputs/Trailer1 Angle" /begin REF_MEASUREMENT analogPot1 /end REF_MEASUREMENT /end GROUP
/begin GROUP S78_Trailer2_Angle "HANcoder_E407_TTA_CombineModel/HANcoder STM32 Target - E407-STM32 algorithm/IO execution/Inputs/Trailer2 Angle" /begin REF_MEASUREMENT analogPot2 /end REF_MEASUREMENT /end GROUP
/begin GROUP S109_2bytes2uint1 "HANcoder_E407_TTA_CombineModel/HANcoder STM32 Target - E407-STM32 algorithm/Message selector/TRCK1_ID2_RX/2bytes2uint1" /begin REF_MEASUREMENT pot22 /end REF_MEASUREMENT /end GROUP
/begin GROUP S109_2bytes2uint16 "HANcoder_E407_TTA_CombineModel/HANcoder STM32 Target - E407-STM32 algorithm/Message selector/TRCK1_ID2_RX/2bytes2uint16" /begin REF_MEASUREMENT pot21 /end REF_MEASUREMENT /end GROUP
/begin GROUP S112_2bytes2uint1 "HANcoder_E407_TTA_CombineModel/HANcoder STM32 Target - E407-STM32 algorithm/Message selector/TRCK1_RX/2bytes2uint1" /begin REF_MEASUREMENT pot12 /end REF_MEASUREMENT /end GROUP
/begin GROUP S112_2bytes2uint16 "HANcoder_E407_TTA_CombineModel/HANcoder STM32 Target - E407-STM32 algorithm/Message selector/TRCK1_RX/2bytes2uint16" /begin REF_MEASUREMENT pot11 /end REF_MEASUREMENT /end GROUP
/begin GROUP S114_2bytes2uint1 "HANcoder_E407_TTA_CombineModel/HANcoder STM32 Target - E407-STM32 algorithm/Message selector/TRCK_ID3_RX/2bytes2uint1" /begin REF_MEASUREMENT pot32 /end REF_MEASUREMENT /end GROUP
/begin GROUP S114_2bytes2uint16 "HANcoder_E407_TTA_CombineModel/HANcoder STM32 Target - E407-STM32 algorithm/Message selector/TRCK_ID3_RX/2bytes2uint16" /begin REF_MEASUREMENT pot31 /end REF_MEASUREMENT /end GROUP
/begin GROUP S115_CAN_receive1 "HANcoder_E407_TTA_CombineModel/HANcoder STM32 Target - E407-STM32 algorithm/Message selector/TRLS_ID4_RX/CAN receive1" /begin SUB_GROUP S276_Enabled_Subsystem /end SUB_GROUP /end GROUP
/begin GROUP S117_CAN_receive1 "HANcoder_E407_TTA_CombineModel/HANcoder STM32 Target - E407-STM32 algorithm/Message selector/TRLS_ID5_RX/CAN receive1" /begin SUB_GROUP S323_Enabled_Subsystem /end SUB_GROUP /end GROUP
/begin GROUP S276_Enabled_Subsystem "HANcoder_E407_TTA_CombineModel/HANcoder STM32 Target - E407-STM32 algorithm/Message selector/TRLS_ID4_RX/CAN receive1/Enabled Subsystem" /begin REF_MEASUREMENT buttonpress1 /end REF_MEASUREMENT /end GROUP
/begin GROUP S323_Enabled_Subsystem "HANcoder_E407_TTA_CombineModel/HANcoder STM32 Target - E407-STM32 algorithm/Message selector/TRLS_ID5_RX/CAN receive1/Enabled Subsystem" /begin REF_MEASUREMENT buttonpress2 /end REF_MEASUREMENT /end GROUP
/begin GROUP S26_Internal_Parameters "HANcoder_E407_TTA_CombineModel/HANcoder STM32 Target - E407-STM32 algorithm/Control execution/Control Algorithm/Discrete PID Controller1/I Gain/Internal Parameters" /begin REF_CHARACTERISTIC intVal /end REF_CHARACTERISTIC /end GROUP
/begin GROUP S34_Internal_Parameters "HANcoder_E407_TTA_CombineModel/HANcoder STM32 Target - E407-STM32 algorithm/Control execution/Control Algorithm/Discrete PID Controller1/Parallel P Gain/Internal Parameters" /begin REF_CHARACTERISTIC propVal /end REF_CHARACTERISTIC /end GROUP
/end MODULE
/end PROJECT
/* (add any file trailer comments here) */
/* EOF HANcoder_E407_TTA_CombineModel.a2l */
