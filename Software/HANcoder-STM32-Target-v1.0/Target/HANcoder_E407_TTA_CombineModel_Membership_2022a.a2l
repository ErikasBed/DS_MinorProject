/******************************************************************************
* ASAP2 file: HANcoder_E407_TTA_CombineModel_Membership_2022a.a2l
* Academic License - for use in teaching, academic research, and meeting
* course requirements at degree granting institutions only. Not for
* government, commercial, or other organizational use.
* Code generation for model "HANcoder_E407_TTA_CombineModel_Membership_2022a".
* Model version : 16.0
* Simulink Coder version : 9.8 (R2022b) 13-May-2022
* C source code generated on : Tue Jun 6 15:53:51 2023
* Target selection: ert.tlc
* Embedded hardware selection: ARM Compatible->ARM Cortex
* Code generation objectives: Unspecified
* Validation result: Not run
* (add additional file header information here)
******************************************************************************/ ASAP2_VERSION 1 31
/* Version 1.31 */
/begin PROJECT ProjectName "HANcoder_E407_TTA_CombineModel_Membership_2022a_softwareID_v1_060623_155241"
/begin HEADER "Header Comments go here" /end HEADER
/begin MODULE ModuleName "Module Comment Goes Here"
/begin MOD_PAR "MOD PAR Comment Goes Here" ADDR_EPK 0x0800c038 CPU_TYPE "STM32F407" ECU "E407" EPK "HANcoder_E407_TTA_CombineModel_Membership_2022a_softwareID_v1_060623_155241"
 SYSTEM_CONSTANT "XcpStationID string length" "0x0000004b"
 SYSTEM_CONSTANT "RAM-FlashOffset" "-402535776" /end MOD_PAR
/begin MOD_COMMON "Mod Common Comment Here" BYTE_ORDER MSB_LAST /end MOD_COMMON
/begin RECORD_LAYOUT Scalar_BOOLEAN FNC_VALUES 1 UBYTE COLUMN_DIR DIRECT /end RECORD_LAYOUT
/begin RECORD_LAYOUT Scalar_UBYTE FNC_VALUES 1 UBYTE COLUMN_DIR DIRECT /end RECORD_LAYOUT
/begin RECORD_LAYOUT Scalar_BYTE FNC_VALUES 1 SBYTE COLUMN_DIR DIRECT /end RECORD_LAYOUT
/begin RECORD_LAYOUT Scalar_UWORD FNC_VALUES 1 UWORD COLUMN_DIR DIRECT /end RECORD_LAYOUT
/begin RECORD_LAYOUT Scalar_SWORD FNC_VALUES 1 SWORD COLUMN_DIR DIRECT /end RECORD_LAYOUT
/begin RECORD_LAYOUT Scalar_ULONG FNC_VALUES 1 ULONG COLUMN_DIR DIRECT /end RECORD_LAYOUT
/begin RECORD_LAYOUT Scalar_LONG FNC_VALUES 1 SLONG COLUMN_DIR DIRECT /end RECORD_LAYOUT
/begin RECORD_LAYOUT Scalar_FLOAT32_IEEE FNC_VALUES 1 FLOAT32_IEEE COLUMN_DIR DIRECT /end RECORD_LAYOUT
/begin RECORD_LAYOUT Scalar_FLOAT64_IEEE FNC_VALUES 1 FLOAT64_IEEE COLUMN_DIR DIRECT /end RECORD_LAYOUT
/begin RECORD_LAYOUT Lookup1D_BYTE FNC_VALUES 1 SBYTE COLUMN_DIR DIRECT /end RECORD_LAYOUT
/begin RECORD_LAYOUT Lookup1D_X_BYTE AXIS_PTS_X 1 SBYTE INDEX_INCR DIRECT /end RECORD_LAYOUT
/begin RECORD_LAYOUT Lookup1D_UBYTE FNC_VALUES 1 UBYTE COLUMN_DIR DIRECT /end RECORD_LAYOUT
/begin RECORD_LAYOUT Lookup1D_X_UBYTE AXIS_PTS_X 1 UBYTE INDEX_INCR DIRECT /end RECORD_LAYOUT
/begin RECORD_LAYOUT Lookup1D_UWORD FNC_VALUES 1 UWORD COLUMN_DIR DIRECT /end RECORD_LAYOUT
/begin RECORD_LAYOUT Lookup1D_X_UWORD AXIS_PTS_X 1 UWORD INDEX_INCR DIRECT /end RECORD_LAYOUT
/begin RECORD_LAYOUT Lookup1D_WORD FNC_VALUES 1 SWORD COLUMN_DIR DIRECT /end RECORD_LAYOUT
/begin RECORD_LAYOUT Lookup1D_X_WORD AXIS_PTS_X 1 SWORD INDEX_INCR DIRECT /end RECORD_LAYOUT
/begin RECORD_LAYOUT Lookup1D_ULONG FNC_VALUES 1 ULONG COLUMN_DIR DIRECT /end RECORD_LAYOUT
/begin RECORD_LAYOUT Lookup1D_X_ULONG AXIS_PTS_X 1 ULONG INDEX_INCR DIRECT /end RECORD_LAYOUT
/begin RECORD_LAYOUT Lookup1D_SLONG FNC_VALUES 1 SLONG COLUMN_DIR DIRECT /end RECORD_LAYOUT
/begin RECORD_LAYOUT Lookup1D_X_LONG AXIS_PTS_X 1 SLONG INDEX_INCR DIRECT /end RECORD_LAYOUT
/begin RECORD_LAYOUT Lookup1D_FLOAT32_IEEE FNC_VALUES 1 FLOAT32_IEEE COLUMN_DIR DIRECT /end RECORD_LAYOUT
/begin RECORD_LAYOUT Lookup1D_X_FLOAT32_IEEE AXIS_PTS_X 1 FLOAT32_IEEE INDEX_INCR DIRECT /end RECORD_LAYOUT
/begin RECORD_LAYOUT Lookup1D_FLOAT64_IEEE FNC_VALUES 1 FLOAT64_IEEE COLUMN_DIR DIRECT /end RECORD_LAYOUT
/begin RECORD_LAYOUT Lookup1D_X_FLOAT64_IEEE AXIS_PTS_X 1 FLOAT64_IEEE INDEX_INCR DIRECT /end RECORD_LAYOUT
/begin RECORD_LAYOUT Lookup2D_UBYTE FNC_VALUES 1 UBYTE COLUMN_DIR DIRECT /end RECORD_LAYOUT
/begin RECORD_LAYOUT Lookup2D_X_UBYTE AXIS_PTS_X 1 UBYTE INDEX_INCR DIRECT /end RECORD_LAYOUT
/begin RECORD_LAYOUT Lookup2D_BYTE FNC_VALUES 1 SBYTE COLUMN_DIR DIRECT /end RECORD_LAYOUT
/begin RECORD_LAYOUT Lookup2D_X_BYTE AXIS_PTS_X 1 SBYTE INDEX_INCR DIRECT /end RECORD_LAYOUT
/begin RECORD_LAYOUT Lookup2D_UWORD FNC_VALUES 1 UWORD COLUMN_DIR DIRECT /end RECORD_LAYOUT
/begin RECORD_LAYOUT Lookup2D_X_UWORD AXIS_PTS_X 1 UWORD INDEX_INCR DIRECT /end RECORD_LAYOUT
/begin RECORD_LAYOUT Lookup2D_WORD FNC_VALUES 1 SWORD COLUMN_DIR DIRECT /end RECORD_LAYOUT
/begin RECORD_LAYOUT Lookup2D_X_WORD AXIS_PTS_X 1 SWORD INDEX_INCR DIRECT /end RECORD_LAYOUT
/begin RECORD_LAYOUT Lookup2D_ULONG FNC_VALUES 1 ULONG COLUMN_DIR DIRECT /end RECORD_LAYOUT
/begin RECORD_LAYOUT Lookup2D_X_ULONG AXIS_PTS_X 1 ULONG INDEX_INCR DIRECT /end RECORD_LAYOUT
/begin RECORD_LAYOUT Lookup2D_LONG FNC_VALUES 1 SLONG COLUMN_DIR DIRECT /end RECORD_LAYOUT
/begin RECORD_LAYOUT Lookup2D_X_LONG AXIS_PTS_X 1 SLONG INDEX_INCR DIRECT /end RECORD_LAYOUT
/begin RECORD_LAYOUT Lookup2D_FLOAT32_IEEE FNC_VALUES 1 FLOAT32_IEEE COLUMN_DIR DIRECT /end RECORD_LAYOUT
/begin RECORD_LAYOUT Lookup2D_X_FLOAT32_IEEE AXIS_PTS_X 1 FLOAT32_IEEE INDEX_INCR DIRECT /end RECORD_LAYOUT
/begin RECORD_LAYOUT Lookup2D_FLOAT64_IEEE FNC_VALUES 1 FLOAT64_IEEE COLUMN_DIR DIRECT /end RECORD_LAYOUT
/begin RECORD_LAYOUT Lookup2D_X_FLOAT64_IEEE AXIS_PTS_X 1 FLOAT64_IEEE INDEX_INCR DIRECT /end RECORD_LAYOUT
/begin CHARACTERISTIC ClockOn "" VALUE 0x20000008 Scalar_FLOAT64_IEEE 0 HANcoder_E407_TTA_CombineModel_Membership_2022a_CM_double -1.7E+308 1.7E+308 /end CHARACTERISTIC
/begin CHARACTERISTIC controlWidth "" VALUE 0x20000030 Scalar_FLOAT64_IEEE 0 HANcoder_E407_TTA_CombineModel_Membership_2022a_CM_double -1.7E+308 1.7E+308 /end CHARACTERISTIC
/begin CHARACTERISTIC desiredAngle "" VALUE 0x20000038 Scalar_FLOAT64_IEEE 0 HANcoder_E407_TTA_CombineModel_Membership_2022a_CM_double -1.7E+308 1.7E+308 /end CHARACTERISTIC
/begin CHARACTERISTIC intVal "" VALUE 0x20000040 Scalar_FLOAT64_IEEE 0 HANcoder_E407_TTA_CombineModel_Membership_2022a_CM_double -1.7E+308 1.7E+308 /end CHARACTERISTIC
/begin CHARACTERISTIC matrixRows "" VALUE 0x20000048 Scalar_FLOAT64_IEEE 0 HANcoder_E407_TTA_CombineModel_Membership_2022a_CM_double -1.7E+308 1.7E+308 /end CHARACTERISTIC
/begin CHARACTERISTIC propVal "" VALUE 0x20000050 Scalar_FLOAT64_IEEE 0 HANcoder_E407_TTA_CombineModel_Membership_2022a_CM_double -1.7E+308 1.7E+308 /end CHARACTERISTIC
/begin CHARACTERISTIC MMBS1_ID "" VALUE 0x20000010 Scalar_ULONG 0 HANcoder_E407_TTA_CombineModel_Membership_2022a_CM_uint32 0 4294967295 /end CHARACTERISTIC
/begin CHARACTERISTIC SSTM1_ID "" VALUE 0x20000014 Scalar_ULONG 0 HANcoder_E407_TTA_CombineModel_Membership_2022a_CM_uint32 0 4294967295 /end CHARACTERISTIC
/begin CHARACTERISTIC SYNC1_ID "" VALUE 0x20000018 Scalar_ULONG 0 HANcoder_E407_TTA_CombineModel_Membership_2022a_CM_uint32 0 4294967295 /end CHARACTERISTIC
/begin CHARACTERISTIC TRCK1_ID1 "" VALUE 0x2000001c Scalar_ULONG 0 HANcoder_E407_TTA_CombineModel_Membership_2022a_CM_uint32 0 4294967295 /end CHARACTERISTIC
/begin CHARACTERISTIC TRCK1_ID2 "" VALUE 0x20000020 Scalar_ULONG 0 HANcoder_E407_TTA_CombineModel_Membership_2022a_CM_uint32 0 4294967295 /end CHARACTERISTIC
/begin CHARACTERISTIC TRCK1_ID3 "" VALUE 0x20000024 Scalar_ULONG 0 HANcoder_E407_TTA_CombineModel_Membership_2022a_CM_uint32 0 4294967295 /end CHARACTERISTIC
/begin CHARACTERISTIC TRLS1_ID4 "" VALUE 0x20000028 Scalar_ULONG 0 HANcoder_E407_TTA_CombineModel_Membership_2022a_CM_uint32 0 4294967295 /end CHARACTERISTIC
/begin CHARACTERISTIC TRLS1_ID5 "" VALUE 0x2000002c Scalar_ULONG 0 HANcoder_E407_TTA_CombineModel_Membership_2022a_CM_uint32 0 4294967295 /end CHARACTERISTIC
/begin CHARACTERISTIC slotTime "" VALUE 0x20000058 Scalar_UBYTE 0 HANcoder_E407_TTA_CombineModel_Membership_2022a_CM_uint8 0 255 /end CHARACTERISTIC
/begin MEASUREMENT reqAngle "" FLOAT64_IEEE HANcoder_E407_TTA_CombineModel_Membership_2022a_CM_double 0 0 -1.7E+308 1.7E+308 ECU_ADDRESS 0x200002c8 /end MEASUREMENT
/begin MEASUREMENT Gamma1 "" FLOAT64_IEEE HANcoder_E407_TTA_CombineModel_Membership_2022a_CM_double 0 0 -1.7E+308 1.7E+308 ECU_ADDRESS 0x20000250 /end MEASUREMENT
/begin MEASUREMENT steering "" FLOAT64_IEEE HANcoder_E407_TTA_CombineModel_Membership_2022a_CM_double 0 0 -1.7E+308 1.7E+308 ECU_ADDRESS 0x20000678 /end MEASUREMENT
/begin MEASUREMENT position "" FLOAT64_IEEE HANcoder_E407_TTA_CombineModel_Membership_2022a_CM_double 0 0 -1.7E+308 1.7E+308 ECU_ADDRESS 0x200002b8 /end MEASUREMENT
/begin MEASUREMENT control "" FLOAT64_IEEE HANcoder_E407_TTA_CombineModel_Membership_2022a_CM_double 0 0 -1.7E+308 1.7E+308 ECU_ADDRESS 0x200002a0 /end MEASUREMENT
/begin MEASUREMENT SI_FreeHeap "" ULONG HANcoder_E407_TTA_CombineModel_Membership_2022a_CM_uint32 0 0 0 4294967295 ECU_ADDRESS 0x2000025c /end MEASUREMENT
/begin MEASUREMENT SI_FreeStack "" ULONG HANcoder_E407_TTA_CombineModel_Membership_2022a_CM_uint32 0 0 0 4294967295 ECU_ADDRESS 0x20000260 /end MEASUREMENT
/begin MEASUREMENT delta12K "" FLOAT32_IEEE HANcoder_E407_TTA_CombineModel_Membership_2022a_CM_single 0 0 -3.4E+38 3.4E+38 ECU_ADDRESS 0x200002ac /end MEASUREMENT
/begin MEASUREMENT t2Angle "" UWORD HANcoder_E407_TTA_CombineModel_Membership_2022a_CM_uint16 0 0 0 65535 ECU_ADDRESS 0x20000682 /end MEASUREMENT
/begin MEASUREMENT t1Angle "" UWORD HANcoder_E407_TTA_CombineModel_Membership_2022a_CM_uint16 0 0 0 65535 ECU_ADDRESS 0x20000680 /end MEASUREMENT
/begin MEASUREMENT Gamma2 "" UWORD HANcoder_E407_TTA_CombineModel_Membership_2022a_CM_uint16 0 0 0 65535 ECU_ADDRESS 0x20000258 /end MEASUREMENT
/begin MEASUREMENT mospeed "" UWORD HANcoder_E407_TTA_CombineModel_Membership_2022a_CM_uint16 0 0 0 65535 ECU_ADDRESS 0x200002b2 /end MEASUREMENT
/begin MEASUREMENT analogPot1 "" UWORD HANcoder_E407_TTA_CombineModel_Membership_2022a_CM_uint16 0 0 0 65535 ECU_ADDRESS 0x20000264 /end MEASUREMENT
/begin MEASUREMENT pot1 "" UWORD HANcoder_E407_TTA_CombineModel_Membership_2022a_CM_uint16 0 0 0 65535 ECU_ADDRESS 0x200002c0 /end MEASUREMENT
/begin MEASUREMENT analogPot2 "" UWORD HANcoder_E407_TTA_CombineModel_Membership_2022a_CM_uint16 0 0 0 65535 ECU_ADDRESS 0x20000266 /end MEASUREMENT
/begin MEASUREMENT pot2 "" UWORD HANcoder_E407_TTA_CombineModel_Membership_2022a_CM_uint16 0 0 0 65535 ECU_ADDRESS 0x200002c2 /end MEASUREMENT
/begin MEASUREMENT testCounter "" UWORD HANcoder_E407_TTA_CombineModel_Membership_2022a_CM_uint16 0 0 0 65535 ECU_ADDRESS 0x20000684 /end MEASUREMENT
/begin MEASUREMENT SI_CPUload "" UBYTE HANcoder_E407_TTA_CombineModel_Membership_2022a_CM_uint8 0 0 0 255 ECU_ADDRESS 0x2000025a /end MEASUREMENT
/begin MEASUREMENT local_ticks_interrupt "" UBYTE HANcoder_E407_TTA_CombineModel_Membership_2022a_CM_uint8 0 0 0 255 ECU_ADDRESS 0x200002b0 /end MEASUREMENT
/begin MEASUREMENT setSlotTime "" UBYTE HANcoder_E407_TTA_CombineModel_Membership_2022a_CM_uint8 0 0 0 255 ECU_ADDRESS 0x20000671 /end MEASUREMENT
/begin MEASUREMENT slotSelected "" UBYTE HANcoder_E407_TTA_CombineModel_Membership_2022a_CM_uint8 0 0 0 255 ECU_ADDRESS 0x20000672 /end MEASUREMENT
/begin MEASUREMENT boolCan "" UBYTE HANcoder_E407_TTA_CombineModel_Membership_2022a_CM_boolean 0 0 0 1 ECU_ADDRESS 0x20000268 /end MEASUREMENT
/begin MEASUREMENT cw "" UBYTE HANcoder_E407_TTA_CombineModel_Membership_2022a_CM_boolean 0 0 0 1 ECU_ADDRESS 0x200002a8 /end MEASUREMENT
/begin MEASUREMENT ccw "" UBYTE HANcoder_E407_TTA_CombineModel_Membership_2022a_CM_boolean 0 0 0 1 ECU_ADDRESS 0x2000029c /end MEASUREMENT
/begin MEASUREMENT canActive "" UBYTE HANcoder_E407_TTA_CombineModel_Membership_2022a_CM_boolean 0 0 0 1 ECU_ADDRESS 0x20000269 /end MEASUREMENT
/begin COMPU_METHOD HANcoder_E407_TTA_CombineModel_Membership_2022a_CM_double "Q = V" RAT_FUNC "%15.10" "" COEFFS 0 1 0 0 0 1 /end COMPU_METHOD
/begin COMPU_METHOD HANcoder_E407_TTA_CombineModel_Membership_2022a_CM_uint32 "Q = V" RAT_FUNC "%10.0" "" COEFFS 0 1 0 0 0 1 /end COMPU_METHOD
/begin COMPU_METHOD HANcoder_E407_TTA_CombineModel_Membership_2022a_CM_uint8 "Q = V" RAT_FUNC "%3.0" "" COEFFS 0 1 0 0 0 1 /end COMPU_METHOD
/begin COMPU_METHOD HANcoder_E407_TTA_CombineModel_Membership_2022a_CM_single "Q = V" RAT_FUNC "%8.6" "" COEFFS 0 1 0 0 0 1 /end COMPU_METHOD
/begin COMPU_METHOD HANcoder_E407_TTA_CombineModel_Membership_2022a_CM_uint16 "Q = V" RAT_FUNC "%5.0" "" COEFFS 0 1 0 0 0 1 /end COMPU_METHOD
/begin COMPU_METHOD HANcoder_E407_TTA_CombineModel_Membership_2022a_CM_boolean "Q = V" RAT_FUNC "%1.0" "" COEFFS 0 1 0 0 0 1 /end COMPU_METHOD
/begin GROUP HANcoder_E407_TTA_CombineModel_Membership_2022a "HANcoder_E407_TTA_CombineModel_Membership_2022a" /* Root */ ROOT /begin SUB_GROUP Root_HANcoder_STM32_Target___E407_STM32_algorithm /end SUB_GROUP /end GROUP
/begin GROUP Root_HANcoder_STM32_Target___E407_STM32_algorithm "HANcoder_E407_TTA_CombineModel_Membership_2022a/HANcoder STM32 Target - E407-STM32 algorithm"
 /begin SUB_GROUP S1_Local_Time_generation S1_Message_selector S1_Role_assignment S1_System_information /end SUB_GROUP
/end GROUP
/begin GROUP S1_Local_Time_generation "HANcoder_E407_TTA_CombineModel_Membership_2022a/HANcoder STM32 Target - E407-STM32 algorithm/Local Time generation" /begin SUB_GROUP S7_Enabled_Subsystem /end SUB_GROUP /begin REF_MEASUREMENT canActive local_ticks_interrupt setSlotTime /end REF_MEASUREMENT /end GROUP
/begin GROUP S1_Message_selector "HANcoder_E407_TTA_CombineModel_Membership_2022a/HANcoder STM32 Target - E407-STM32 algorithm/Message selector" /begin SUB_GROUP S8_SYNC1_TX S8_Slot_5_execution S8_Subsystem /end SUB_GROUP
 /begin REF_CHARACTERISTIC MMBS1_ID SSTM1_ID SYNC1_ID TRCK1_ID1 TRCK1_ID2 TRCK1_ID3 TRLS1_ID4 TRLS1_ID5 /end REF_CHARACTERISTIC
 /begin REF_MEASUREMENT boolCan /end REF_MEASUREMENT
/end GROUP
/begin GROUP S1_Role_assignment "HANcoder_E407_TTA_CombineModel_Membership_2022a/HANcoder STM32 Target - E407-STM32 algorithm/Role assignment" /begin SUB_GROUP S10_Subsystem S10_Subsystem2 /end SUB_GROUP /begin REF_CHARACTERISTIC ClockOn /end REF_CHARACTERISTIC /end GROUP
/begin GROUP S1_System_information "HANcoder_E407_TTA_CombineModel_Membership_2022a/HANcoder STM32 Target - E407-STM32 algorithm/System information" /begin SUB_GROUP S16_Get_CPU_load S16_Get_free_Heap S16_Get_free_Stack /end SUB_GROUP /end GROUP
/begin GROUP S7_Enabled_Subsystem "HANcoder_E407_TTA_CombineModel_Membership_2022a/HANcoder STM32 Target - E407-STM32 algorithm/Local Time generation/Enabled Subsystem" /begin REF_CHARACTERISTIC matrixRows /end REF_CHARACTERISTIC /begin REF_MEASUREMENT slotSelected /end REF_MEASUREMENT /end GROUP
/begin GROUP S8_SYNC1_TX "HANcoder_E407_TTA_CombineModel_Membership_2022a/HANcoder STM32 Target - E407-STM32 algorithm/Message selector/SYNC1_TX" /begin REF_MEASUREMENT testCounter /end REF_MEASUREMENT /end GROUP
/begin GROUP S8_Slot_5_execution "HANcoder_E407_TTA_CombineModel_Membership_2022a/HANcoder STM32 Target - E407-STM32 algorithm/Message selector/Slot 5 execution" /begin SUB_GROUP S28_Inputs /end SUB_GROUP /end GROUP
/begin GROUP S8_Subsystem "HANcoder_E407_TTA_CombineModel_Membership_2022a/HANcoder STM32 Target - E407-STM32 algorithm/Message selector/Subsystem" /begin SUB_GROUP S29_Control_Algorithm S29_Kinematic_Algorithm /end SUB_GROUP /begin REF_MEASUREMENT reqAngle t1Angle t2Angle /end REF_MEASUREMENT /end GROUP
/begin GROUP S10_Subsystem "HANcoder_E407_TTA_CombineModel_Membership_2022a/HANcoder STM32 Target - E407-STM32 algorithm/Role assignment/Subsystem" /begin REF_CHARACTERISTIC slotTime /end REF_CHARACTERISTIC /end GROUP
/begin GROUP S10_Subsystem2 "HANcoder_E407_TTA_CombineModel_Membership_2022a/HANcoder STM32 Target - E407-STM32 algorithm/Role assignment/Subsystem2" /begin REF_CHARACTERISTIC SYNC1_ID /end REF_CHARACTERISTIC /end GROUP
/begin GROUP S16_Get_CPU_load "HANcoder_E407_TTA_CombineModel_Membership_2022a/HANcoder STM32 Target - E407-STM32 algorithm/System information/Get CPU load" /begin REF_MEASUREMENT SI_CPUload /end REF_MEASUREMENT /end GROUP
/begin GROUP S16_Get_free_Heap "HANcoder_E407_TTA_CombineModel_Membership_2022a/HANcoder STM32 Target - E407-STM32 algorithm/System information/Get free Heap" /begin REF_MEASUREMENT SI_FreeHeap /end REF_MEASUREMENT /end GROUP
/begin GROUP S16_Get_free_Stack "HANcoder_E407_TTA_CombineModel_Membership_2022a/HANcoder STM32 Target - E407-STM32 algorithm/System information/Get free Stack" /begin REF_MEASUREMENT SI_FreeStack /end REF_MEASUREMENT /end GROUP
/begin GROUP S28_Inputs "HANcoder_E407_TTA_CombineModel_Membership_2022a/HANcoder STM32 Target - E407-STM32 algorithm/Message selector/Slot 5 execution/Inputs" /begin SUB_GROUP S50_Trailer1_Angle S50_Trailer2_Angle /end SUB_GROUP /begin REF_CHARACTERISTIC desiredAngle /end REF_CHARACTERISTIC /begin REF_MEASUREMENT pot1 pot2 /end REF_MEASUREMENT /end GROUP
/begin GROUP S29_Control_Algorithm "HANcoder_E407_TTA_CombineModel_Membership_2022a/HANcoder STM32 Target - E407-STM32 algorithm/Message selector/Subsystem/Control Algorithm" /begin REF_CHARACTERISTIC controlWidth /end REF_CHARACTERISTIC /begin REF_MEASUREMENT ccw control cw mospeed position steering /end REF_MEASUREMENT /end GROUP
/begin GROUP S29_Kinematic_Algorithm "HANcoder_E407_TTA_CombineModel_Membership_2022a/HANcoder STM32 Target - E407-STM32 algorithm/Message selector/Subsystem/Kinematic Algorithm" /begin SUB_GROUP S63_Steer_angle_at_steer_axle /end SUB_GROUP /begin REF_MEASUREMENT Gamma1 Gamma2 /end REF_MEASUREMENT /end GROUP
/begin GROUP S50_Trailer1_Angle "HANcoder_E407_TTA_CombineModel_Membership_2022a/HANcoder STM32 Target - E407-STM32 algorithm/Message selector/Slot 5 execution/Inputs/Trailer1 Angle" /begin REF_MEASUREMENT analogPot1 /end REF_MEASUREMENT /end GROUP
/begin GROUP S50_Trailer2_Angle "HANcoder_E407_TTA_CombineModel_Membership_2022a/HANcoder STM32 Target - E407-STM32 algorithm/Message selector/Slot 5 execution/Inputs/Trailer2 Angle" /begin REF_MEASUREMENT analogPot2 /end REF_MEASUREMENT /end GROUP
/begin GROUP S63_Steer_angle_at_steer_axle "HANcoder_E407_TTA_CombineModel_Membership_2022a/HANcoder STM32 Target - E407-STM32 algorithm/Message selector/Subsystem/Kinematic Algorithm/Steer angle at steer axle" /begin REF_MEASUREMENT delta12K /end REF_MEASUREMENT /end GROUP
/begin GROUP S69_Internal_Parameters "HANcoder_E407_TTA_CombineModel_Membership_2022a/HANcoder STM32 Target - E407-STM32 algorithm/Message selector/Subsystem/Control Algorithm/Discrete PID Controller1/I Gain/Internal Parameters" /begin REF_CHARACTERISTIC intVal /end REF_CHARACTERISTIC /end GROUP
/begin GROUP S77_Internal_Parameters "HANcoder_E407_TTA_CombineModel_Membership_2022a/HANcoder STM32 Target - E407-STM32 algorithm/Message selector/Subsystem/Control Algorithm/Discrete PID Controller1/Parallel P Gain/Internal Parameters" /begin REF_CHARACTERISTIC propVal /end REF_CHARACTERISTIC /end GROUP
/end MODULE
/end PROJECT
/* (add any file trailer comments here) */
/* EOF HANcoder_E407_TTA_CombineModel_Membership_2022a.a2l */
