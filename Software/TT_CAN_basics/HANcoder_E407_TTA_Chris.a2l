/******************************************************************************
* ASAP2 file: HANcoder_E407_TTA_Chris.a2l
* Academic License - for use in teaching, academic research, and meeting
* course requirements at degree granting institutions only. Not for
* government, commercial, or other organizational use.
* Code generation for model "HANcoder_E407_TTA_Chris".
* Model version : 17.8
* Simulink Coder version : 9.8 (R2022b) 13-May-2022
* C source code generated on : Sun May 14 18:45:07 2023
* Target selection: ert.tlc
* Embedded hardware selection: ARM Compatible->ARM Cortex
* Code generation objectives: Unspecified
* Validation result: Not run
* (add additional file header information here)
******************************************************************************/ ASAP2_VERSION 1 31
/* Version 1.31 */
/begin PROJECT ProjectName "HANcoder_E407_TTA_Chris_softwareID_v1_140523_184501"
/begin HEADER "Header Comments go here" /end HEADER
/begin MODULE ModuleName "Module Comment Goes Here"
/begin MOD_PAR "MOD PAR Comment Goes Here" ADDR_EPK 0x0800c014 CPU_TYPE "STM32F407" ECU "E407" EPK "HANcoder_E407_TTA_Chris_softwareID_v1_140523_184501"
 SYSTEM_CONSTANT "XcpStationID string length" "0x00000033"
 SYSTEM_CONSTANT "RAM-FlashOffset" "-402551392" /end MOD_PAR
/begin MOD_COMMON "Mod Common Comment Here" BYTE_ORDER MSB_LAST /end MOD_COMMON
/begin RECORD_LAYOUT Scalar_BOOLEAN FNC_VALUES 1 UBYTE COLUMN_DIR DIRECT /end RECORD_LAYOUT
/begin RECORD_LAYOUT Scalar_UBYTE FNC_VALUES 1 UBYTE COLUMN_DIR DIRECT /end RECORD_LAYOUT
/begin RECORD_LAYOUT Scalar_BYTE FNC_VALUES 1 SBYTE COLUMN_DIR DIRECT /end RECORD_LAYOUT
/begin RECORD_LAYOUT Scalar_UWORD FNC_VALUES 1 UWORD COLUMN_DIR DIRECT /end RECORD_LAYOUT
/begin RECORD_LAYOUT Scalar_SWORD FNC_VALUES 1 SWORD COLUMN_DIR DIRECT /end RECORD_LAYOUT
/begin RECORD_LAYOUT Scalar_ULONG FNC_VALUES 1 ULONG COLUMN_DIR DIRECT /end RECORD_LAYOUT
/begin RECORD_LAYOUT Scalar_LONG FNC_VALUES 1 SLONG COLUMN_DIR DIRECT /end RECORD_LAYOUT
/begin RECORD_LAYOUT Scalar_FLOAT32_IEEE FNC_VALUES 1 FLOAT32_IEEE COLUMN_DIR DIRECT /end RECORD_LAYOUT
/begin RECORD_LAYOUT Scalar_FLOAT64_IEEE FNC_VALUES 1 FLOAT64_IEEE COLUMN_DIR DIRECT /end RECORD_LAYOUT
/begin RECORD_LAYOUT Lookup1D_BYTE FNC_VALUES 1 SBYTE COLUMN_DIR DIRECT /end RECORD_LAYOUT
/begin RECORD_LAYOUT Lookup1D_X_BYTE AXIS_PTS_X 1 SBYTE INDEX_INCR DIRECT /end RECORD_LAYOUT
/begin RECORD_LAYOUT Lookup1D_UBYTE FNC_VALUES 1 UBYTE COLUMN_DIR DIRECT /end RECORD_LAYOUT
/begin RECORD_LAYOUT Lookup1D_X_UBYTE AXIS_PTS_X 1 UBYTE INDEX_INCR DIRECT /end RECORD_LAYOUT
/begin RECORD_LAYOUT Lookup1D_UWORD FNC_VALUES 1 UWORD COLUMN_DIR DIRECT /end RECORD_LAYOUT
/begin RECORD_LAYOUT Lookup1D_X_UWORD AXIS_PTS_X 1 UWORD INDEX_INCR DIRECT /end RECORD_LAYOUT
/begin RECORD_LAYOUT Lookup1D_WORD FNC_VALUES 1 SWORD COLUMN_DIR DIRECT /end RECORD_LAYOUT
/begin RECORD_LAYOUT Lookup1D_X_WORD AXIS_PTS_X 1 SWORD INDEX_INCR DIRECT /end RECORD_LAYOUT
/begin RECORD_LAYOUT Lookup1D_ULONG FNC_VALUES 1 ULONG COLUMN_DIR DIRECT /end RECORD_LAYOUT
/begin RECORD_LAYOUT Lookup1D_X_ULONG AXIS_PTS_X 1 ULONG INDEX_INCR DIRECT /end RECORD_LAYOUT
/begin RECORD_LAYOUT Lookup1D_SLONG FNC_VALUES 1 SLONG COLUMN_DIR DIRECT /end RECORD_LAYOUT
/begin RECORD_LAYOUT Lookup1D_X_LONG AXIS_PTS_X 1 SLONG INDEX_INCR DIRECT /end RECORD_LAYOUT
/begin RECORD_LAYOUT Lookup1D_FLOAT32_IEEE FNC_VALUES 1 FLOAT32_IEEE COLUMN_DIR DIRECT /end RECORD_LAYOUT
/begin RECORD_LAYOUT Lookup1D_X_FLOAT32_IEEE AXIS_PTS_X 1 FLOAT32_IEEE INDEX_INCR DIRECT /end RECORD_LAYOUT
/begin RECORD_LAYOUT Lookup1D_FLOAT64_IEEE FNC_VALUES 1 FLOAT64_IEEE COLUMN_DIR DIRECT /end RECORD_LAYOUT
/begin RECORD_LAYOUT Lookup1D_X_FLOAT64_IEEE AXIS_PTS_X 1 FLOAT64_IEEE INDEX_INCR DIRECT /end RECORD_LAYOUT
/begin RECORD_LAYOUT Lookup2D_UBYTE FNC_VALUES 1 UBYTE COLUMN_DIR DIRECT /end RECORD_LAYOUT
/begin RECORD_LAYOUT Lookup2D_X_UBYTE AXIS_PTS_X 1 UBYTE INDEX_INCR DIRECT /end RECORD_LAYOUT
/begin RECORD_LAYOUT Lookup2D_BYTE FNC_VALUES 1 SBYTE COLUMN_DIR DIRECT /end RECORD_LAYOUT
/begin RECORD_LAYOUT Lookup2D_X_BYTE AXIS_PTS_X 1 SBYTE INDEX_INCR DIRECT /end RECORD_LAYOUT
/begin RECORD_LAYOUT Lookup2D_UWORD FNC_VALUES 1 UWORD COLUMN_DIR DIRECT /end RECORD_LAYOUT
/begin RECORD_LAYOUT Lookup2D_X_UWORD AXIS_PTS_X 1 UWORD INDEX_INCR DIRECT /end RECORD_LAYOUT
/begin RECORD_LAYOUT Lookup2D_WORD FNC_VALUES 1 SWORD COLUMN_DIR DIRECT /end RECORD_LAYOUT
/begin RECORD_LAYOUT Lookup2D_X_WORD AXIS_PTS_X 1 SWORD INDEX_INCR DIRECT /end RECORD_LAYOUT
/begin RECORD_LAYOUT Lookup2D_ULONG FNC_VALUES 1 ULONG COLUMN_DIR DIRECT /end RECORD_LAYOUT
/begin RECORD_LAYOUT Lookup2D_X_ULONG AXIS_PTS_X 1 ULONG INDEX_INCR DIRECT /end RECORD_LAYOUT
/begin RECORD_LAYOUT Lookup2D_LONG FNC_VALUES 1 SLONG COLUMN_DIR DIRECT /end RECORD_LAYOUT
/begin RECORD_LAYOUT Lookup2D_X_LONG AXIS_PTS_X 1 SLONG INDEX_INCR DIRECT /end RECORD_LAYOUT
/begin RECORD_LAYOUT Lookup2D_FLOAT32_IEEE FNC_VALUES 1 FLOAT32_IEEE COLUMN_DIR DIRECT /end RECORD_LAYOUT
/begin RECORD_LAYOUT Lookup2D_X_FLOAT32_IEEE AXIS_PTS_X 1 FLOAT32_IEEE INDEX_INCR DIRECT /end RECORD_LAYOUT
/begin RECORD_LAYOUT Lookup2D_FLOAT64_IEEE FNC_VALUES 1 FLOAT64_IEEE COLUMN_DIR DIRECT /end RECORD_LAYOUT
/begin RECORD_LAYOUT Lookup2D_X_FLOAT64_IEEE AXIS_PTS_X 1 FLOAT64_IEEE INDEX_INCR DIRECT /end RECORD_LAYOUT
/begin CHARACTERISTIC ClockOn "" VALUE 0x20000008 Scalar_FLOAT64_IEEE 0 HANcoder_E407_TTA_Chris_CM_double -1.7E+308 1.7E+308 /end CHARACTERISTIC
/begin CHARACTERISTIC matrixRows "" VALUE 0x20000018 Scalar_FLOAT64_IEEE 0 HANcoder_E407_TTA_Chris_CM_double -1.7E+308 1.7E+308 /end CHARACTERISTIC
/begin CHARACTERISTIC idA "" VALUE 0x20000010 Scalar_ULONG 0 HANcoder_E407_TTA_Chris_CM_uint32 0 4294967295 /end CHARACTERISTIC
/begin CHARACTERISTIC idB "" VALUE 0x20000014 Scalar_ULONG 0 HANcoder_E407_TTA_Chris_CM_uint32 0 4294967295 /end CHARACTERISTIC
/begin CHARACTERISTIC slotTime "" VALUE 0x20000020 Scalar_UBYTE 0 HANcoder_E407_TTA_Chris_CM_uint8 0 255 /end CHARACTERISTIC
/begin MEASUREMENT SI_FreeHeap "" ULONG HANcoder_E407_TTA_Chris_CM_uint32 0 0 0 4294967295 ECU_ADDRESS 0x2000020c /end MEASUREMENT
/begin MEASUREMENT SI_FreeStack "" ULONG HANcoder_E407_TTA_Chris_CM_uint32 0 0 0 4294967295 ECU_ADDRESS 0x20000210 /end MEASUREMENT
/begin MEASUREMENT local_ticks_interrupt "" UWORD HANcoder_E407_TTA_Chris_CM_uint16 0 0 0 65535 ECU_ADDRESS 0x2000023c /end MEASUREMENT
/begin MEASUREMENT SI_CPUload "" UBYTE HANcoder_E407_TTA_Chris_CM_uint8 0 0 0 255 ECU_ADDRESS 0x20000208 /end MEASUREMENT
/begin MEASUREMENT setSlotTime "" UBYTE HANcoder_E407_TTA_Chris_CM_uint8 0 0 0 255 ECU_ADDRESS 0x20000265 /end MEASUREMENT
/begin MEASUREMENT slotSelected "" UBYTE HANcoder_E407_TTA_Chris_CM_uint8 0 0 0 255 ECU_ADDRESS 0x20000266 /end MEASUREMENT
/begin MEASUREMENT dataBtx "" UBYTE HANcoder_E407_TTA_Chris_CM_uint8 0 0 0 255 ECU_ADDRESS 0x2000023b /end MEASUREMENT
/begin MEASUREMENT dataBrx "" UBYTE HANcoder_E407_TTA_Chris_CM_uint8 0 0 0 255 ECU_ADDRESS 0x2000023a /end MEASUREMENT
/begin MEASUREMENT dataAtx "" UBYTE HANcoder_E407_TTA_Chris_CM_uint8 0 0 0 255 ECU_ADDRESS 0x20000239 /end MEASUREMENT
/begin MEASUREMENT dataArx "" UBYTE HANcoder_E407_TTA_Chris_CM_uint8 0 0 0 255 ECU_ADDRESS 0x20000238 /end MEASUREMENT
/begin MEASUREMENT roleB "" UBYTE HANcoder_E407_TTA_Chris_CM_boolean 0 0 0 1 ECU_ADDRESS 0x2000023f /end MEASUREMENT
/begin MEASUREMENT roleA "" UBYTE HANcoder_E407_TTA_Chris_CM_boolean 0 0 0 1 ECU_ADDRESS 0x2000023e /end MEASUREMENT
/begin MEASUREMENT canActive "" UBYTE HANcoder_E407_TTA_Chris_CM_boolean 0 0 0 1 ECU_ADDRESS 0x20000214 /end MEASUREMENT
/begin COMPU_METHOD HANcoder_E407_TTA_Chris_CM_double "Q = V" RAT_FUNC "%15.10" "" COEFFS 0 1 0 0 0 1 /end COMPU_METHOD
/begin COMPU_METHOD HANcoder_E407_TTA_Chris_CM_uint32 "Q = V" RAT_FUNC "%10.0" "" COEFFS 0 1 0 0 0 1 /end COMPU_METHOD
/begin COMPU_METHOD HANcoder_E407_TTA_Chris_CM_uint8 "Q = V" RAT_FUNC "%3.0" "" COEFFS 0 1 0 0 0 1 /end COMPU_METHOD
/begin COMPU_METHOD HANcoder_E407_TTA_Chris_CM_uint16 "Q = V" RAT_FUNC "%5.0" "" COEFFS 0 1 0 0 0 1 /end COMPU_METHOD
/begin COMPU_METHOD HANcoder_E407_TTA_Chris_CM_boolean "Q = V" RAT_FUNC "%1.0" "" COEFFS 0 1 0 0 0 1 /end COMPU_METHOD
/begin GROUP HANcoder_E407_TTA_Chris "HANcoder_E407_TTA_Chris" /* Root */ ROOT /begin SUB_GROUP Root_HANcoder_STM32_Target___E407_STM32_algorithm /end SUB_GROUP /end GROUP
/begin GROUP Root_HANcoder_STM32_Target___E407_STM32_algorithm "HANcoder_E407_TTA_Chris/HANcoder STM32 Target - E407-STM32 algorithm"
 /begin SUB_GROUP S1_Communication S1_Inputs S1_Local_Time_generation S1_Role_assignment S1_System_information /end SUB_GROUP
/end GROUP
/begin GROUP S1_Communication "HANcoder_E407_TTA_Chris/HANcoder STM32 Target - E407-STM32 algorithm/Communication" /begin SUB_GROUP S4_Role_A_Rx S4_Role_A_Tx S4_Role_B_Rx S4_Role_B_Tx /end SUB_GROUP /end GROUP
/begin GROUP S1_Inputs "HANcoder_E407_TTA_Chris/HANcoder STM32 Target - E407-STM32 algorithm/Inputs" /begin REF_MEASUREMENT roleA roleB /end REF_MEASUREMENT /end GROUP
/begin GROUP S1_Local_Time_generation "HANcoder_E407_TTA_Chris/HANcoder STM32 Target - E407-STM32 algorithm/Local Time generation" /begin SUB_GROUP S9_Enabled_Subsystem /end SUB_GROUP /begin REF_MEASUREMENT canActive local_ticks_interrupt setSlotTime /end REF_MEASUREMENT /end GROUP
/begin GROUP S1_Role_assignment "HANcoder_E407_TTA_Chris/HANcoder STM32 Target - E407-STM32 algorithm/Role assignment" /begin SUB_GROUP S11_Subsystem /end SUB_GROUP /begin REF_CHARACTERISTIC ClockOn /end REF_CHARACTERISTIC /end GROUP
/begin GROUP S1_System_information "HANcoder_E407_TTA_Chris/HANcoder STM32 Target - E407-STM32 algorithm/System information" /begin SUB_GROUP S12_Get_CPU_load S12_Get_free_Heap S12_Get_free_Stack /end SUB_GROUP /end GROUP
/begin GROUP S4_Role_A_Rx "HANcoder_E407_TTA_Chris/HANcoder STM32 Target - E407-STM32 algorithm/Communication/Role A Rx" /begin SUB_GROUP S15_CAN_receive1 /end SUB_GROUP /begin REF_CHARACTERISTIC idB /end REF_CHARACTERISTIC /end GROUP
/begin GROUP S4_Role_A_Tx "HANcoder_E407_TTA_Chris/HANcoder STM32 Target - E407-STM32 algorithm/Communication/Role A Tx" /begin REF_CHARACTERISTIC idA /end REF_CHARACTERISTIC /begin REF_MEASUREMENT dataAtx /end REF_MEASUREMENT /end GROUP
/begin GROUP S4_Role_B_Rx "HANcoder_E407_TTA_Chris/HANcoder STM32 Target - E407-STM32 algorithm/Communication/Role B Rx" /begin SUB_GROUP S17_CAN_receive1 /end SUB_GROUP /begin REF_CHARACTERISTIC idA /end REF_CHARACTERISTIC /end GROUP
/begin GROUP S4_Role_B_Tx "HANcoder_E407_TTA_Chris/HANcoder STM32 Target - E407-STM32 algorithm/Communication/Role B Tx" /begin REF_CHARACTERISTIC idB /end REF_CHARACTERISTIC /begin REF_MEASUREMENT dataBtx /end REF_MEASUREMENT /end GROUP
/begin GROUP S9_Enabled_Subsystem "HANcoder_E407_TTA_Chris/HANcoder STM32 Target - E407-STM32 algorithm/Local Time generation/Enabled Subsystem" /begin REF_CHARACTERISTIC matrixRows /end REF_CHARACTERISTIC /begin REF_MEASUREMENT slotSelected /end REF_MEASUREMENT /end GROUP
/begin GROUP S11_Subsystem "HANcoder_E407_TTA_Chris/HANcoder STM32 Target - E407-STM32 algorithm/Role assignment/Subsystem" /begin REF_CHARACTERISTIC slotTime /end REF_CHARACTERISTIC /end GROUP
/begin GROUP S12_Get_CPU_load "HANcoder_E407_TTA_Chris/HANcoder STM32 Target - E407-STM32 algorithm/System information/Get CPU load" /begin REF_MEASUREMENT SI_CPUload /end REF_MEASUREMENT /end GROUP
/begin GROUP S12_Get_free_Heap "HANcoder_E407_TTA_Chris/HANcoder STM32 Target - E407-STM32 algorithm/System information/Get free Heap" /begin REF_MEASUREMENT SI_FreeHeap /end REF_MEASUREMENT /end GROUP
/begin GROUP S12_Get_free_Stack "HANcoder_E407_TTA_Chris/HANcoder STM32 Target - E407-STM32 algorithm/System information/Get free Stack" /begin REF_MEASUREMENT SI_FreeStack /end REF_MEASUREMENT /end GROUP
/begin GROUP S15_CAN_receive1 "HANcoder_E407_TTA_Chris/HANcoder STM32 Target - E407-STM32 algorithm/Communication/Role A Rx/CAN receive1" /begin SUB_GROUP S19_Enabled_Subsystem /end SUB_GROUP /end GROUP
/begin GROUP S17_CAN_receive1 "HANcoder_E407_TTA_Chris/HANcoder STM32 Target - E407-STM32 algorithm/Communication/Role B Rx/CAN receive1" /begin SUB_GROUP S22_Enabled_Subsystem /end SUB_GROUP /end GROUP
/begin GROUP S19_Enabled_Subsystem "HANcoder_E407_TTA_Chris/HANcoder STM32 Target - E407-STM32 algorithm/Communication/Role A Rx/CAN receive1/Enabled Subsystem" /begin REF_MEASUREMENT dataArx /end REF_MEASUREMENT /end GROUP
/begin GROUP S22_Enabled_Subsystem "HANcoder_E407_TTA_Chris/HANcoder STM32 Target - E407-STM32 algorithm/Communication/Role B Rx/CAN receive1/Enabled Subsystem" /begin REF_MEASUREMENT dataBrx /end REF_MEASUREMENT /end GROUP
/end MODULE
/end PROJECT
/* (add any file trailer comments here) */
/* EOF HANcoder_E407_TTA_Chris.a2l */
